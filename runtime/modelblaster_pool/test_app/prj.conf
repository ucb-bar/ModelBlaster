## CMakeLists.txt
```
# SPDX-License-Identifier: Apache-2.0
#
# Standalone unit-test for modelblaster_pool. Builds a Zephyr binary that:
#   1. Creates an modelblaster_pool of size 4.
#   2. Runs modelblaster_pool_parallelize_1d with a function that sums into
#      per-worker buckets, then re-checks the bucket totals.
#   3. Prints PASS/FAIL between begin/end markers + a tiny per-call
#      cycles datapoint so we can sanity-check it's in the same
#      ballpark as the bench's pthreads_raw row.
#
# Build:
#   west build -p -b spike_riscv64 \
#       modelblaster/runtime/modelblaster_pool/test_app
#   spike -p4 --isa=rv64gcv_zicntr build/zephyr/zephyr.elf
#
# For FireSim, layer in the existing chipyard overlay:
#   west build -p -b chipyard_riscv64/rocketchip_virt_riscv64 \
#       modelblaster/runtime/modelblaster_pool/test_app -- \
#       -DEXTRA_CONF_FILE=$(realpath modelblaster/harness/backends/firesim_chipyard.conf)

cmake_minimum_required(VERSION 3.20.0)

# Apply the vendored POSIX-affinity patch idempotently — same logic as
# harness_multi/. Workers in modelblaster_pool need
# pthread_attr_setaffinity_np to land on the right hart.
set(_AFFINITY_PATCH
    "${CMAKE_CURRENT_LIST_DIR}/../../../harness_multi/zephyr_patches/posix-affinity.patch")
set(_ZEPHYR_TREE "$ENV{ZEPHYR_BASE}")
if(EXISTS "${_AFFINITY_PATCH}" AND IS_DIRECTORY "${_ZEPHYR_TREE}")
    execute_process(
        COMMAND git -C "${_ZEPHYR_TREE}" apply --reverse --check "${_AFFINITY_PATCH}"
        RESULT_VARIABLE _patch_already_applied
        OUTPUT_QUIET ERROR_QUIET
    )
    if(NOT _patch_already_applied EQUAL 0)
        execute_process(
            COMMAND git -C "${_ZEPHYR_TREE}" apply --check "${_AFFINITY_PATCH}"
            RESULT_VARIABLE _patch_clean
            ERROR_VARIABLE _patch_check_err
        )
        if(NOT _patch_clean EQUAL 0)
            message(FATAL_ERROR
                "modelblaster_pool/test_app: POSIX-affinity patch does not apply cleanly:\n"
                "${_patch_check_err}")
        endif()
        execute_process(
            COMMAND git -C "${_ZEPHYR_TREE}" apply "${_AFFINITY_PATCH}"
            RESULT_VARIABLE _patch_apply
        )
        if(NOT _patch_apply EQUAL 0)
            message(FATAL_ERROR
                "modelblaster_pool/test_app: POSIX-affinity patch failed to apply.")
        endif()
    endif()
endif()

find_package(Zephyr REQUIRED HINTS $ENV{ZEPHYR_BASE})
project(modelblaster_pool_test_app)

# Pull in modelblaster_pool as an OBJECT lib via add_subdirectory.
add_subdirectory(${CMAKE_CURRENT_LIST_DIR}/.. modelblaster_pool_build)

target_sources(app PRIVATE src/main.c)
target_link_libraries(app PRIVATE modelblaster_pool)

# Same RISC-V relax workaround the model harnesses apply, in case a
# future test variant grows large data tables.
zephyr_link_libraries(-Wl,--no-relax)
```

## sample.yaml
```
sample:
  description: modelblaster_pool unit test (raw-pthread parallel-for)
  name: modelblaster_pool_test_app
common:
  tags: modelblaster runtime modelblaster_pool
  integration_platforms:
    - spike_riscv64
  harness: console
  harness_config:
    type: multi_line
    regex:
      - "=== MODELBLASTER_POOL_TEST_BEGIN ==="
      - "=== MODELBLASTER_POOL_TEST_END ==="
tests:
  sample.modelblaster.runtime.modelblaster_pool:
    tags: modelblaster
```

## prj.conf
```kconfig
# modelblaster_pool unit test — same SMP / POSIX / picolibc footprint as the
# multi-model harness so the test exercises modelblaster_pool under the same
# Zephyr config the production harnesses use.
CONFIG_THREAD_STACK_INFO=y
CONFIG_MP_MAX_NUM_CPUS=4
CONFIG_SMP=y
CONFIG_MAIN_STACK_SIZE=1048576
CONFIG_THREAD_STACK_MEM_MAPPED=y
CONFIG_DYNAMIC_THREAD=y
CONFIG_DYNAMIC_THREAD_STACK_SIZE=16384
CONFIG_DYNAMIC_THREAD_ALLOC=y

CONFIG_SCHED_CPU_MASK=y
CONFIG_SCHED_CPU_MASK_PIN_ONLY=n
CONFIG_SCHED_DUMB=y

CONFIG_POSIX_API=y
CONFIG_MULTITHREADING=y
CONFIG_POSIX_THREADS=y
# pthread_attr_setaffinity_np (vendored Phase A patch — see
# modelblaster/harness_multi/zephyr_patches/posix-affinity.patch).
CONFIG_POSIX_THREADS_AFFINITY=y

CONFIG_FPU=y
CONFIG_CBPRINTF_FP_SUPPORT=y
CONFIG_HEAP_MEM_POOL_SIZE=1048576

CONFIG_GNU_C_EXTENSIONS=y
CONFIG_STD_C17=y
CONFIG_PICOLIBC=y
CONFIG_COMMON_LIBC_MALLOC=y
CONFIG_COMMON_LIBC_MALLOC_ARENA_SIZE=8388608
```

## src/main.c
```c
/*
 * Copyright (c) 2026 The Authors
 * SPDX-License-Identifier: Apache-2.0
 *
 * Unit test for modelblaster_pool. Runs three correctness checks:
 *
 *   1. parallelize_1d over a known range exactly invokes fn once per i
 *      (every input is touched exactly once, no overlap, no gaps).
 *   2. The accumulated sum across all workers matches the
 *      sequential-loop reference.
 *   3. modelblaster_pool_get_threads_count() reports the value passed to
 *      create().
 *
 * Then prints a tiny perf number — per-call cycles for a small fixed
 * range (32) at N=4 — so we can sanity-check it lands within ~2x of
 * the bench_pthreads_raw row in the threadpool microbench's
 * firesim_overhead.csv (~20k cycles per call there).
 *
 * Output protocol: PASS/FAIL between MODELBLASTER_POOL_TEST_{BEGIN,END}
 * markers; the runner script greps for these. Per-call cycles is
 * emitted as a single PERF line so the perf check is structured.
 */

#include "modelblaster_pool.h"

#include <stdint.h>
#include <stdio.h>
#include <string.h>

#include <zephyr/kernel.h>
#include <zephyr/sys/reboot.h>

#define TEST_RANGE 1024
#define TEST_REPS  16

static unsigned long long touch_count[TEST_RANGE];

/* Fn body: increment touch_count[i] (for the "every i seen exactly
 * once" check) and accumulate i*i into a per-call partial sum used by
 * the second test below. The volatile qualifier on `partial_sum`
 * (declared in main as a struct member that the worker reads/writes)
 * keeps the compiler from elision-folding the work; modelblaster_pool runs
 * fn slices in series on each helper so the writes within one slice
 * don't race. */
struct test_ctx {
	volatile unsigned long long *bucket;  /* length n_workers */
	int n_workers;
	size_t per;
};

static void touch_fn(void *ctx_, size_t i)
{
	struct test_ctx *c = (struct test_ctx *)ctx_;
	(void)c;
	if (i < TEST_RANGE) {
		touch_count[i]++;
	}
}

/* Bucketed-sum body. Each helper accumulates into bucket[wid] where
 * wid is derived from i / per (per = ceil(range / n_workers)). This
 * verifies that the slicing inside modelblaster_pool maps i correctly to
 * the helper that owns it: when we sum bucket[0..n-1] we should get
 * exactly the closed-form sum_{i=0..range-1} i. */
static void bucket_fn(void *ctx_, size_t i)
{
	struct test_ctx *c = (struct test_ctx *)ctx_;
	int wid = (int)(i / c->per);
	if (wid >= c->n_workers) {
		wid = c->n_workers - 1;
	}
	c->bucket[wid] += (unsigned long long)i;
}

static inline uint64_t rdcycle64(void)
{
	uint64_t v;
	__asm__ volatile("rdcycle %0" : "=r"(v));
	return v;
}

int main(void)
{
	int fail = 0;

	printf("modelblaster_pool_test: starting on %s (MP_MAX_NUM_CPUS=%d)\n",
	       CONFIG_BOARD_TARGET, (int)CONFIG_MP_MAX_NUM_CPUS);

	/* Pin master to hart 0 so the affinity-pinned helpers (1..N-1)
	 * don't fight master for hart placement. The harness model
	 * mains do the same. */
	k_thread_cpu_pin(k_current_get(), 0);

	const int N = 4;
	modelblaster_pool_t pool = modelblaster_pool_create(N);
	if (pool == NULL) {
		printf("=== MODELBLASTER_POOL_TEST_BEGIN ===\n");
		printf("FAIL: modelblaster_pool_create(%d) returned NULL\n", N);
		printf("=== MODELBLASTER_POOL_TEST_END ===\n");
		sys_reboot(SYS_REBOOT_COLD);
		return -1;
	}

	unsigned tcount = modelblaster_pool_get_threads_count(pool);
	printf("modelblaster_pool_test: pool create OK, threads=%u\n", tcount);

	/* --- Test 1: every i in [0, range) is visited exactly once. -- */
	memset(touch_count, 0, sizeof(touch_count));
	struct test_ctx ctx = { 0 };
	modelblaster_pool_parallelize_1d(pool, touch_fn, &ctx, TEST_RANGE, 0);
	int touch_fail = 0;
	for (int i = 0; i < TEST_RANGE; i++) {
		if (touch_count[i] != 1ULL) {
			if (touch_fail < 4) {
				printf("  TOUCH FAIL i=%d count=%llu\n",
				       i, (unsigned long long)touch_count[i]);
			}
			touch_fail++;
		}
	}
	if (touch_fail) {
		printf("  TEST1 FAIL: %d slots not touched exactly once\n",
		       touch_fail);
		fail++;
	}

	/* --- Test 2: per-worker bucket sums to the closed-form total. ----
	 *
	 * sum_{i=0..N-1} i = N*(N-1)/2. With range=TEST_RANGE this is
	 * TEST_RANGE * (TEST_RANGE - 1) / 2 = 523776 for TEST_RANGE=1024.
	 */
	unsigned long long buckets[16] = { 0 };
	struct test_ctx bctx = {
		.bucket = buckets,
		.n_workers = (int)tcount,
		.per = (TEST_RANGE + tcount - 1) / tcount,
	};
	modelblaster_pool_parallelize_1d(pool, bucket_fn, &bctx, TEST_RANGE, 0);
	unsigned long long total = 0;
	for (unsigned w = 0; w < tcount; w++) {
		total += buckets[w];
	}
	unsigned long long expected =
		(unsigned long long)TEST_RANGE *
		(unsigned long long)(TEST_RANGE - 1) / 2ULL;
	if (total != expected) {
		printf("  TEST2 FAIL: sum=%llu expected=%llu\n",
		       total, expected);
		fail++;
	}

	/* --- Test 3: get_threads_count returns N. --------------------- */
	if (tcount != (unsigned)N) {
		printf("  TEST3 FAIL: get_threads_count=%u expected=%d\n",
		       tcount, N);
		fail++;
	}

	/* --- Perf sanity: per-call cycles for range=32 at N=4. -------- */
	uint64_t per_call_min = (uint64_t)-1;
	uint64_t per_call_sum = 0;
	for (int rep = 0; rep < TEST_REPS; rep++) {
		uint64_t t0 = rdcycle64();
		modelblaster_pool_parallelize_1d(pool, touch_fn, &ctx, 32, 0);
		uint64_t t1 = rdcycle64();
		uint64_t d = t1 - t0;
		if (d < per_call_min) {
			per_call_min = d;
		}
		per_call_sum += d;
	}
	uint64_t per_call_avg = per_call_sum / (uint64_t)TEST_REPS;

	modelblaster_pool_destroy(pool);

	/* --- Final report --------------------------------------------- */
	printf("=== MODELBLASTER_POOL_TEST_BEGIN ===\n");
	if (fail) {
		printf("FAIL: %d sub-tests failed\n", fail);
	} else {
		printf("PASS: 3/3 sub-tests passed\n");
	}
	printf("PERF: range=32 N=%d reps=%d per_call_cycles min=%llu avg=%llu\n",
	       N, TEST_REPS,
	       (unsigned long long)per_call_min,
	       (unsigned long long)per_call_avg);
	printf("=== MODELBLASTER_POOL_TEST_END ===\n");

	sys_reboot(SYS_REBOOT_COLD);
	return fail ? -1 : 0;
}
```
