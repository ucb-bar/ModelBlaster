## CMakeLists.txt
```
# SPDX-License-Identifier: Apache-2.0
#
# Threadpool microbench harness. Builds one of three benchmark binaries
# (selected via -DBENCH_TARGET={pthreadpool,zephyr_threads,pthreads_raw})
# with the same SMP / POSIX / pthreadpool footprint the multi-model
# harness uses, so the measurements transfer directly.
#
# Pass:
#   -DBENCH_TARGET=<pthreadpool|zephyr_threads|pthreads_raw>
#   -DBENCH_PTHREADPOOL_VARIANT=<default|spin>   (only meaningful when
#       BENCH_TARGET=pthreadpool; "spin" disables the cond_wait fallback
#       by linking a pthreadpool that's been compiled with
#       PTHREADPOOL_SYNC_PRIMITIVE=condvar plus a large
#       PTHREADPOOL_SPIN_WAIT_ITERATIONS, effectively keeping the
#       master in its spin loop the whole wait.) Two variants get
#       distinct CMake target names so they can co-exist.
#
# Includes the same vendored POSIX-affinity patch hook as
# modelblaster/harness_multi/CMakeLists.txt and a copy of the patch file in
# zephyr_patches/.

cmake_minimum_required(VERSION 3.20.0)

if(NOT DEFINED BENCH_TARGET)
    set(BENCH_TARGET "pthreadpool")
endif()
set(_VALID_TARGETS "pthreadpool" "zephyr_threads" "pthreads_raw")
list(FIND _VALID_TARGETS "${BENCH_TARGET}" _idx)
if(_idx EQUAL -1)
    message(FATAL_ERROR
        "BENCH_TARGET='${BENCH_TARGET}' must be one of: ${_VALID_TARGETS}")
endif()

if(NOT DEFINED BENCH_PTHREADPOOL_VARIANT)
    set(BENCH_PTHREADPOOL_VARIANT "default")
endif()

# Apply the vendored POSIX-affinity patch idempotently (same logic as
# harness_multi). Workers in bench_pthreads_raw need
# pthread_attr_setaffinity_np to land on the right hart.
set(_AFFINITY_PATCH
    "${CMAKE_CURRENT_LIST_DIR}/../../harness_multi/zephyr_patches/posix-affinity.patch")
set(_ZEPHYR_TREE "$ENV{ZEPHYR_BASE}")
if(EXISTS "${_AFFINITY_PATCH}" AND IS_DIRECTORY "${_ZEPHYR_TREE}")
    execute_process(
        COMMAND git -C "${_ZEPHYR_TREE}" apply --reverse --check "${_AFFINITY_PATCH}"
        RESULT_VARIABLE _patch_already_applied
        OUTPUT_QUIET ERROR_QUIET
    )
    if(_patch_already_applied EQUAL 0)
        message(STATUS "microbench: POSIX-affinity patch already applied")
    else()
        execute_process(
            COMMAND git -C "${_ZEPHYR_TREE}" apply --check "${_AFFINITY_PATCH}"
            RESULT_VARIABLE _patch_clean
            ERROR_VARIABLE _patch_check_err
        )
        if(NOT _patch_clean EQUAL 0)
            message(FATAL_ERROR
                "microbench: POSIX-affinity patch does not apply cleanly:\n"
                "${_patch_check_err}")
        endif()
        execute_process(
            COMMAND git -C "${_ZEPHYR_TREE}" apply "${_AFFINITY_PATCH}"
            RESULT_VARIABLE _patch_apply
        )
        if(NOT _patch_apply EQUAL 0)
            message(FATAL_ERROR "microbench: POSIX-affinity patch failed.")
        endif()
        message(STATUS "microbench: applied POSIX-affinity patch")
    endif()
endif()

find_package(Zephyr REQUIRED HINTS $ENV{ZEPHYR_BASE})
project(modelblaster_microbench_threadpool)

# Wire pthreadpool only if the target needs it. We keep the same
# vendored copy as harness_multi.
if(BENCH_TARGET STREQUAL "pthreadpool")
    set(_REPO_ROOT_ABS "${CMAKE_CURRENT_LIST_DIR}/../../..")
    set(PTHREADPOOL_SOURCE_DIR
        "${_REPO_ROOT_ABS}/third-party/executorch/backends/xnnpack/third-party/pthreadpool"
        CACHE STRING "pthreadpool source directory")
    set(FXDIV_SOURCE_DIR
        "${_REPO_ROOT_ABS}/third-party/executorch/backends/xnnpack/third-party/FXdiv"
        CACHE STRING "FXdiv source directory")
    set(PTHREADPOOL_BUILD_TESTS      OFF CACHE BOOL "")
    set(PTHREADPOOL_BUILD_BENCHMARKS OFF CACHE BOOL "")
    set(PTHREADPOOL_ALLOW_DEPRECATED_API OFF CACHE BOOL "")

    if(BENCH_PTHREADPOOL_VARIANT STREQUAL "spin")
        # "spin" variant: ratchet PTHREADPOOL_SPIN_WAIT_ITERATIONS to a
        # value larger than any reasonable cross-hart wake time so the
        # master never falls back to pthread_cond_wait. The default in
        # threadpool-common.h is 1_000_000; on FireSim a single spin
        # iteration is one yield()-equivalent which is ~kcycles, so
        # 1M may already be enough — but bumping it removes any doubt.
        # We override via a target-level compile definition. To make
        # the override take effect on the THIRD-PARTY pthreadpool target
        # (which is added by add_subdirectory), we set it as a CMake
        # CACHE variable that the pthreadpool target picks up via its
        # own definitions list.
        # NOTE: pthreadpool's CMakeLists doesn't actually expose this
        # constant, so we patch it via a compile-definition that
        # overrides the macro for the pthreadpool TU. The PRIVATE
        # define on the pthreadpool target post-add_subdirectory works
        # because the macro is referenced in src/pthreads.c which is
        # compiled into the pthreadpool target.
    endif()

    add_subdirectory("${PTHREADPOOL_SOURCE_DIR}" pthreadpool_build)
    target_link_libraries(pthreadpool PRIVATE zephyr_interface)

    if(BENCH_PTHREADPOOL_VARIANT STREQUAL "spin")
        # 100 million spin iters — enough for any cross-hart wake on
        # this RTL. We can't override it via -D (pthreadpool's
        # threadpool-common.h unconditionally `#define`s the macro
        # later in the TU) and the brief forbids editing the vendored
        # source. The trick: -include forcibly inserts our header at
        # the very top of every pthreadpool .c, so by the time
        # threadpool-common.h is `#include`d its include guard is
        # already satisfied (our copy uses the same `#pragma once`).
        # spin_overrides/threadpool-common.h is a byte-identical copy
        # of upstream's header except for the bumped spin constant.
        target_compile_options(pthreadpool PRIVATE
            -include "${CMAKE_CURRENT_LIST_DIR}/spin_overrides/spin_inject.h")
        message(STATUS "microbench: pthreadpool variant=spin "
                       "(100M spin iters via -include override)")
    else()
        message(STATUS "microbench: pthreadpool variant=default "
                       "(condvar fallback after 1M spins)")
    endif()
endif()

# Pick the source file. All three share bench_common.h — pulled in
# via target_include_directories.
set(_SRC_DIR "${CMAKE_CURRENT_LIST_DIR}/src")
if(BENCH_TARGET STREQUAL "pthreadpool")
    target_sources(app PRIVATE "${_SRC_DIR}/bench_pthreadpool.c")
elseif(BENCH_TARGET STREQUAL "zephyr_threads")
    target_sources(app PRIVATE "${_SRC_DIR}/bench_zephyr_threads.c")
elseif(BENCH_TARGET STREQUAL "pthreads_raw")
    target_sources(app PRIVATE "${_SRC_DIR}/bench_pthreads_raw.c")
endif()
target_include_directories(app PRIVATE "${_SRC_DIR}")

if(BENCH_TARGET STREQUAL "pthreadpool")
    target_link_libraries(app PRIVATE pthreadpool)
    target_compile_definitions(app PRIVATE
        BENCH_PTHREADPOOL_VARIANT_NAME="${BENCH_PTHREADPOOL_VARIANT}")
endif()

# Same RISC-V relax workaround the model harnesses apply.
zephyr_link_libraries(-Wl,--no-relax)

message(STATUS "microbench: BENCH_TARGET=${BENCH_TARGET} "
               "variant=${BENCH_PTHREADPOOL_VARIANT}")
```

## sample.yaml
```
sample:
  description: Cross-hart threadpool dispatch microbenchmarks
  name: modelblaster_microbench_threadpool
common:
  tags: modelblaster microbench threadpool
  integration_platforms:
    - spike_riscv64
  harness: console
  harness_config:
    type: multi_line
    regex:
      - "=== THREADPOOL_BENCH_BEGIN ==="
tests:
  sample.modelblaster.microbench_threadpool:
    tags: modelblaster
```

## prj.conf
```kconfig
# Threadpool microbench harness — same SMP / POSIX / picolibc footprint
# as modelblaster/harness_multi/, so the build behaves the same across spike
# and the FireSim chipyard board. The pthreadpool source we link
# against is the executorch-vendored pthreadpool that the multi-model
# harness uses.
CONFIG_THREAD_STACK_INFO=y
CONFIG_MP_MAX_NUM_CPUS=4
CONFIG_SMP=y
# 1 MB main stack — we don't have the giant DroNet VLAs but we do
# allocate static cycle-sample buffers of a few KB. 1 MB has plenty of
# headroom; the FireSim overlay below shrinks it for the FPGA build
# where the RAM region is laid out differently.
CONFIG_MAIN_STACK_SIZE=1048576
CONFIG_THREAD_STACK_MEM_MAPPED=y
CONFIG_DYNAMIC_THREAD=y
CONFIG_DYNAMIC_THREAD_STACK_SIZE=16384
CONFIG_DYNAMIC_THREAD_ALLOC=y

CONFIG_SCHED_CPU_MASK=y
CONFIG_SCHED_CPU_MASK_PIN_ONLY=n
CONFIG_SCHED_DUMB=y

CONFIG_POSIX_API=y
CONFIG_MULTITHREADING=y
CONFIG_POSIX_THREADS=y
# pthread_attr_setaffinity_np (vendored Phase A patch — see
# modelblaster/harness_multi/zephyr_patches/posix-affinity.patch).
CONFIG_POSIX_THREADS_AFFINITY=y

CONFIG_FPU=y
CONFIG_CBPRINTF_FP_SUPPORT=y
CONFIG_HEAP_MEM_POOL_SIZE=1048576

CONFIG_GNU_C_EXTENSIONS=y
CONFIG_STD_C17=y
CONFIG_PICOLIBC=y
CONFIG_COMMON_LIBC_MALLOC=y
CONFIG_COMMON_LIBC_MALLOC_ARENA_SIZE=8388608
```

## src/bench_common.h
```c
/*
 * Copyright (c) 2026 The Authors
 * SPDX-License-Identifier: Apache-2.0
 *
 * Shared helpers for the cross-hart synchronization microbenchmarks under
 * modelblaster/microbench/threadpool/. The three harnesses (pthreadpool,
 * raw POSIX pthreads, native k_thread+k_sem) all share:
 *   - rdcycle() for per-call cycle deltas (matches the existing
 *     harness's profiling primitive at the 1 GHz target frequency)
 *   - bench_workload_t — the trivial fanned-out body each harness
 *     dispatches across N harts. Tunable in size to expose the cliff
 *     where dispatch overhead dwarfs the work
 *   - results_emit_csv() — prints a single CSV block bracketed by
 *     THREADPOOL_BENCH_{BEGIN,END} markers so the host-side parser can
 *     pick it up regardless of which simulator produced it
 *
 * Per the HTIF UART lesson (FireSim's HTIF is extremely slow; printing
 * inside a timed region starves any worker pinned to hart 0), all
 * printf calls are deferred until after every measurement loop.
 */

#ifndef MODELBLASTER_MICROBENCH_THREADPOOL_BENCH_COMMON_H
#define MODELBLASTER_MICROBENCH_THREADPOOL_BENCH_COMMON_H

#include <stddef.h>
#include <stdint.h>
#include <stdio.h>

/* RV64 cycle counter at the core's clock (1 GHz target on FireSim
 * quad-rocket-saturn). Inlined so the read happens at the call site
 * with no extra branch / spill.
 *
 * IMPORTANT: rdcycle reads a per-hart counter, not a global one. Each
 * hart's `cycle` CSR counts only the cycles where THIS hart was
 * retiring instructions, so two rdcycle reads on different harts are
 * NOT directly comparable — a worker hart that's been mostly idle
 * since boot can have a cycle value that's millions of cycles below
 * the master's even though they're sampling "at the same wall time".
 * Use `bench_rdmtime` for cross-hart timestamps.
 */
static inline uint64_t bench_rdcycle(void)
{
	uint64_t v;
	__asm__ volatile("rdcycle %0" : "=r"(v));
	return v;
}

/* Global mtime read — coherent across harts. mtime ticks at 1 MHz on
 * the FireSim quad-rocket-saturn build (CONFIG_SYS_CLOCK_HW_CYCLES_PER_SEC),
 * so 1 mtime tick = 1000 target-clock cycles at 1 GHz. The breakdown
 * fields (wake_to_first_worker, etc.) report mtime ticks; convert by
 * multiplying by 1000 to get target cycles, or treat the column as
 * "microseconds at 1 GHz target".
 *
 * On spike, sys_clock_cycle_get_64 returns the same global tick
 * source (spike's clint), so cross-hart values are still comparable;
 * only the rate differs (spike runs at host speed). */
#include <zephyr/sys_clock.h>
static inline uint64_t bench_rdmtime(void)
{
	return sys_clock_cycle_get_64();
}

/* The trivial per-element body each harness dispatches. Tiny on
 * purpose: the point of the benchmark is to characterize *dispatch
 * overhead*, not steady-state throughput. The compiler can't elide it
 * because `out` is declared volatile in the worker (see the harnesses).
 *
 * range = number of elements; each worker processes a contiguous
 * sub-slice. The body is float multiply so the FPU is exercised
 * (matches the kernels that pthreadpool dispatches on in production).
 */
typedef struct {
	const float *in;
	volatile float *out;
	size_t range;
} bench_workload_t;

static inline void bench_apply(const bench_workload_t *wl,
			       size_t start, size_t end)
{
	for (size_t i = start; i < end; i++) {
		wl->out[i] = wl->in[i] * 2.0f;
	}
}

/* CSV row for one (harness, N, range) tuple. We collect these into a
 * fixed-size array on the stack and print the whole batch at the end.
 * Per-iteration cycles are summarized by min/median/max — the spread
 * matters when (e.g.) the first call after warmup includes a JIT-style
 * bring-up cost that isn't representative of steady state.
 *
 * UNITS:
 *   per_call_{min,med,max} — target-clock cycles (master rdcycle delta).
 *   wake_to_first_worker
 *   wake_to_all_finished
 *   finish_to_observed   — mtime ticks (global counter; on FireSim
 *                           quad-rocket-saturn 1 tick = 1 µs target =
 *                           1000 target cycles). Cross-hart-correct
 *                           because mtime is global; rdcycle wouldn't
 *                           be (per-hart counter).
 */
typedef struct {
	const char *harness;	/* "pthreadpool", "pthreads_raw", "k_thread" */
	const char *variant;	/* "default", "spin", "yield" — free-form tag */
	int n_workers;
	int range;
	int reps;
	uint64_t per_call_min;	    /* target cycles */
	uint64_t per_call_med;	    /* target cycles */
	uint64_t per_call_max;	    /* target cycles */
	uint64_t wake_to_first_worker; /* mtime ticks */
	uint64_t wake_to_all_finished; /* mtime ticks */
	uint64_t finish_to_observed;   /* mtime ticks */
} bench_row_t;

/* Median of an in-place buffer. Quick + dirty insertion-sort (reps is
 * O(1k)). Sorts the buffer as a side-effect; caller must accept that. */
static inline uint64_t bench_median_inplace(uint64_t *buf, size_t n)
{
	for (size_t i = 1; i < n; i++) {
		uint64_t v = buf[i];
		size_t j = i;
		while (j > 0 && buf[j - 1] > v) {
			buf[j] = buf[j - 1];
			j--;
		}
		buf[j] = v;
	}
	return n ? buf[n / 2] : 0;
}

static inline uint64_t bench_min(const uint64_t *buf, size_t n)
{
	uint64_t v = buf[0];
	for (size_t i = 1; i < n; i++) {
		if (buf[i] < v) {
			v = buf[i];
		}
	}
	return v;
}

static inline uint64_t bench_max(const uint64_t *buf, size_t n)
{
	uint64_t v = buf[0];
	for (size_t i = 1; i < n; i++) {
		if (buf[i] > v) {
			v = buf[i];
		}
	}
	return v;
}

/* Emit one CSV block. Markers are intentionally distinct from
 * MODELBLASTER_OUTPUT_BEGIN/END so the existing runner doesn't try to parse
 * floats out of them.
 *
 * Schema:
 *   harness,variant,n_workers,range,reps,
 *   per_call_min,per_call_med,per_call_max,
 *   wake_to_first_worker,wake_to_all_finished,finish_to_observed
 */
static inline void bench_emit_csv(const bench_row_t *rows, size_t n)
{
	printf("=== THREADPOOL_BENCH_BEGIN ===\n");
	printf("harness,variant,n_workers,range,reps,"
	       "per_call_min,per_call_med,per_call_max,"
	       "wake_to_first_worker,wake_to_all_finished,"
	       "finish_to_observed\n");
	for (size_t i = 0; i < n; i++) {
		printf("%s,%s,%d,%d,%d,%llu,%llu,%llu,%llu,%llu,%llu\n",
		       rows[i].harness, rows[i].variant,
		       rows[i].n_workers, rows[i].range, rows[i].reps,
		       (unsigned long long)rows[i].per_call_min,
		       (unsigned long long)rows[i].per_call_med,
		       (unsigned long long)rows[i].per_call_max,
		       (unsigned long long)rows[i].wake_to_first_worker,
		       (unsigned long long)rows[i].wake_to_all_finished,
		       (unsigned long long)rows[i].finish_to_observed);
	}
	printf("=== THREADPOOL_BENCH_END ===\n");
}

/* Sweep configuration shared by all three harnesses. Kept identical
 * across the harnesses so the rows of the resulting CSV are directly
 * comparable. */
#define BENCH_RANGE_COUNT 3
static const int BENCH_RANGES[BENCH_RANGE_COUNT] = { 32, 256, 4096 };

#define BENCH_NWORKERS_COUNT 3
static const int BENCH_NWORKERS[BENCH_NWORKERS_COUNT] = { 1, 2, 4 };

/* Rep counts. Trade-off: more reps = tighter median + lower noise on
 * the breakdown averages; fewer reps = much shorter FireSim runs.
 * pthreadpool's dispatch path costs ~13M target cycles per rep, so
 * 256 reps × 9 sweeps would be ~30B cycles (~500s of FireSim host
 * time at our ~60 MHz host clock). 24 reps keeps a single full sweep
 * under ~3B target cycles ≈ ~1 minute of host wallclock per
 * pthreadpool variant, which fits the lab cadence. The cheap
 * harnesses (k_thread, pthreads_raw) finish in seconds either way. */
#define BENCH_WARMUP_REPS 8
#define BENCH_TIMED_REPS  24

/* Static-sized I/O buffers — sized for the largest range we sweep.
 * Both buffers are 4-byte aligned (float). Declared in main TUs because
 * each harness owns its own copies (no shared linker scope across
 * separate elf builds). */
#define BENCH_MAX_RANGE 4096

#endif /* MODELBLASTER_MICROBENCH_THREADPOOL_BENCH_COMMON_H */
```

## src/bench_pthreadpool.c
```c
/*
 * Copyright (c) 2026 The Authors
 * SPDX-License-Identifier: Apache-2.0
 *
 * Bench #1: pthreadpool dispatch overhead.
 *
 * Mirrors the way modelblaster/harness_multi/ uses pthreadpool: create a pool
 * of N workers, then call pthreadpool_parallelize_1d in a tight loop
 * with a trivial body. Per-call cycles are read via rdcycle() at the
 * caller (the master thread), bracketing each parallelize_1d call —
 * this is the exact cost the model loop pays per dispatch.
 *
 * pthreadpool's portable backend (the one we vendor via executorch) is
 * pthread_cond_*-based by default; PTHREADPOOL_SYNC_PRIMITIVE='condvar'
 * in its CMakeLists.txt. The master thread inside parallelize already
 * spins (PTHREADPOOL_SPIN_WAIT_ITERATIONS = 1M) before falling back to
 * pthread_cond_wait, so on a fast SoC we'd see the spin path; on
 * FireSim's quad-rocket-saturn the wait can fall through to the
 * cond_wait path because the worker takes long enough to land on the
 * other hart.
 *
 * NOTE: there is no in-band way to time the master wake -> first worker
 * cycle here (pthreadpool's internals are private). The other two
 * harnesses (k_thread + raw POSIX) use explicit semaphores so they CAN
 * measure that breakdown — the comparison across the three is exactly
 * how we attribute cost to the wrapper layer.
 *
 * Print everything AFTER the timed loops; printing on hart 0 during
 * timing would block the master while the HTIF UART drains. (See the
 * xpurt walker incident referenced in the project memory.)
 */

#include <pthreadpool.h>

#include <pthread.h>
#include <sched.h>
#include <stdint.h>
#include <stdio.h>
#include <stdlib.h>
#include <string.h>

#include <zephyr/arch/cpu.h>
#include <zephyr/kernel.h>
#include <zephyr/sys/reboot.h>

#include "bench_common.h"

/* Workload buffers — file-static so they're in BSS, not on the main
 * stack (Zephyr's main stack is 512 KB on the FireSim build, and we
 * don't want VLA pressure in this critical path). */
static float bench_in[BENCH_MAX_RANGE];
static volatile float bench_out[BENCH_MAX_RANGE];

/* pthreadpool's task signature: (context, index). For 1d
 * parallelize_1d the worker is invoked once per index in [0, range). We
 * coalesce contiguous index ranges into one body call by using
 * parallelize_1d_tile_1d instead — but pthreadpool's tile variant adds
 * its own quanta-management overhead. Stick with the plain 1d API: it's
 * the one models actually use, so its dispatch cost is what we want to
 * characterize. */
static void task_1d(void *ctx, size_t i)
{
	bench_workload_t *wl = (bench_workload_t *)ctx;
	wl->out[i] = wl->in[i] * 2.0f;
}

static int memalign_shim_used; /* keep the linker happy */

/* picolibc + pthreadpool wants memalign + posix_memalign in the linked
 * binary. The multi-model harness's generated multi_main.c provides
 * these for the same reason; we re-declare them locally. */
void *memalign(size_t alignment, size_t size)
{
	memalign_shim_used = 1;
	return aligned_alloc(alignment, size);
}

int posix_memalign(void **out, size_t alignment, size_t size)
{
	void *p = aligned_alloc(alignment, size);
	if (!p) {
		return 12; /* ENOMEM */
	}
	*out = p;
	return 0;
}

static void run_one(bench_row_t *row, pthreadpool_t pool,
		    int n_workers, int range)
{
	bench_workload_t wl = { .in = bench_in, .out = bench_out,
				.range = (size_t)range };

	/* Warmup so any first-call setup (lazy worker thread spawn,
	 * cache lines for the threadpool struct) doesn't pollute the
	 * timed samples. */
	for (int i = 0; i < BENCH_WARMUP_REPS; i++) {
		pthreadpool_parallelize_1d(pool, task_1d, &wl,
					   (size_t)range, 0);
	}

	static uint64_t samples[BENCH_TIMED_REPS];
	for (int i = 0; i < BENCH_TIMED_REPS; i++) {
		uint64_t t0 = bench_rdcycle();
		pthreadpool_parallelize_1d(pool, task_1d, &wl,
					   (size_t)range, 0);
		uint64_t t1 = bench_rdcycle();
		samples[i] = t1 - t0;
	}

	row->harness = "pthreadpool";
#ifdef BENCH_PTHREADPOOL_VARIANT_NAME
	row->variant = BENCH_PTHREADPOOL_VARIANT_NAME;
#else
	row->variant = "default";
#endif
	row->n_workers = n_workers;
	row->range = range;
	row->reps = BENCH_TIMED_REPS;
	row->per_call_min = bench_min(samples, BENCH_TIMED_REPS);
	row->per_call_max = bench_max(samples, BENCH_TIMED_REPS);
	row->per_call_med = bench_median_inplace(samples, BENCH_TIMED_REPS);
	/* pthreadpool internals are opaque to us — leave the breakdown
	 * fields zero. The k_thread + raw-pthread harnesses fill these in. */
	row->wake_to_first_worker = 0;
	row->wake_to_all_finished = 0;
	row->finish_to_observed = 0;
}

/* Single-shot k_sem ping/pong on the master hart, to baseline the
 * primitive-itself cost (hart-local, no IPI). One round = give + take.
 * Used to interpret the cross-hart numbers from the other harnesses. */
static struct k_sem ping_sem;

static void bench_local_sem(uint64_t *out_med, uint64_t *out_min,
			    uint64_t *out_max)
{
	k_sem_init(&ping_sem, 0, 1);
	for (int i = 0; i < BENCH_WARMUP_REPS; i++) {
		k_sem_give(&ping_sem);
		k_sem_take(&ping_sem, K_FOREVER);
	}
	static uint64_t s[BENCH_TIMED_REPS];
	for (int i = 0; i < BENCH_TIMED_REPS; i++) {
		uint64_t t0 = bench_rdcycle();
		k_sem_give(&ping_sem);
		k_sem_take(&ping_sem, K_FOREVER);
		uint64_t t1 = bench_rdcycle();
		s[i] = t1 - t0;
	}
	*out_min = bench_min(s, BENCH_TIMED_REPS);
	*out_max = bench_max(s, BENCH_TIMED_REPS);
	*out_med = bench_median_inplace(s, BENCH_TIMED_REPS);
}

int main(void)
{
	printf("bench_pthreadpool: starting on %s "
	       "(MP_MAX_NUM_CPUS=%d)\n",
	       CONFIG_BOARD_TARGET, (int)CONFIG_MP_MAX_NUM_CPUS);
	/* Pin master to hart 0 so cross-rdcycle pairs always land on
	 * the same per-hart cycle counter on spike. (FireSim's harts
	 * share a coherent counter so this is a no-op there.) */
	k_thread_cpu_pin(k_current_get(), 0);

	/* Touch the input buffer so it's resident, not zero-page-COW. */
	for (int i = 0; i < BENCH_MAX_RANGE; i++) {
		bench_in[i] = (float)i;
	}

	/* Local-sem baseline first — independent of pool state. */
	uint64_t sem_med = 0, sem_min = 0, sem_max = 0;
	bench_local_sem(&sem_med, &sem_min, &sem_max);

	/* Sweep N x range. We tear down + recreate the pool per N
	 * because pthreadpool_create takes a fixed worker count. */
	bench_row_t rows[BENCH_NWORKERS_COUNT * BENCH_RANGE_COUNT];
	int rcount = 0;
	for (int ni = 0; ni < BENCH_NWORKERS_COUNT; ni++) {
		int n = BENCH_NWORKERS[ni];
		pthreadpool_t pool = pthreadpool_create((size_t)n);
		if (!pool) {
			printf("FATAL: pthreadpool_create(%d) returned NULL\n",
			       n);
			sys_reboot(SYS_REBOOT_COLD);
			return -1;
		}
		for (int ri = 0; ri < BENCH_RANGE_COUNT; ri++) {
			run_one(&rows[rcount++], pool, n, BENCH_RANGES[ri]);
		}
		pthreadpool_destroy(pool);
	}

	/* Print the local-sem baseline as a synthetic row first so it
	 * lands inside the same parser block. n_workers=0 marks it. */
	bench_row_t base = {
		.harness = "k_sem_pingpong",
		.variant = "local",
		.n_workers = 0,
		.range = 0,
		.reps = BENCH_TIMED_REPS,
		.per_call_min = sem_min,
		.per_call_med = sem_med,
		.per_call_max = sem_max,
	};
	bench_emit_csv(&base, 1);
	bench_emit_csv(rows, rcount);

	printf("bench_pthreadpool: done\n");
	sys_reboot(SYS_REBOOT_COLD);
	return 0;
}
```

## src/bench_pthreads_raw.c
```c
/*
 * Copyright (c) 2026 The Authors
 * SPDX-License-Identifier: Apache-2.0
 *
 * Bench #3: raw POSIX pthreads (no pthreadpool wrapper) over Zephyr's
 * POSIX layer.
 *
 * Spawns N pthreads, each pinned to a hart via
 * pthread_attr_setaffinity_np (the vendored Phase-A patch — see
 * modelblaster/harness_multi/zephyr_patches/posix-affinity.patch). Each
 * worker spins on a per-worker semaphore, processes its slice, signals
 * a per-worker done semaphore. The master gives all start sems then
 * takes all done sems.
 *
 * Functionally identical wake/wait pattern to bench_zephyr_threads but
 * crossing pthread boundaries — `pthread_create` paths through
 * Zephyr's POSIX shim onto k_thread under the hood. Comparing this
 * harness's per-call cycles to bench_zephyr_threads.c isolates the
 * POSIX-layer overhead; comparing it to bench_pthreadpool isolates
 * pthreadpool's own wrapper overhead (queue management, command-state
 * machine, FPU-save fences) on top of POSIX.
 *
 * We use Zephyr k_sem (not POSIX sem_t) for the rendezvous so the
 * primitive cost matches bench_zephyr_threads. The variable being
 * isolated here is *thread spawn / scheduling layer*, not the sem.
 */

#include <pthread.h>
#include <sched.h>
#include <stdint.h>
#include <stdio.h>
#include <stdlib.h>
#include <string.h>

#include <zephyr/arch/cpu.h>
#include <zephyr/kernel.h>
#include <zephyr/sys/reboot.h>

#include "bench_common.h"

#define BENCH_MAX_WORKERS 4

static struct k_sem start_sem[BENCH_MAX_WORKERS];
static struct k_sem done_sem[BENCH_MAX_WORKERS];

struct bench_iter_state {
	const float *in;
	volatile float *out;
	size_t range;
	int n_workers;
	int active;
	volatile uint64_t first_worker;
	volatile uint64_t last_done;
};
static volatile struct bench_iter_state iter;

static void *worker_fn(void *arg)
{
	int wid = (int)(uintptr_t)arg;
	for (;;) {
		k_sem_take(&start_sem[wid], K_FOREVER);
		/* mtime, NOT rdcycle — see bench_zephyr_threads.c for
		 * the cross-hart counter caveat. */
		uint64_t t_wake = bench_rdmtime();
		if (iter.active == 0) {
			return NULL;
		}
		uint64_t cur = iter.first_worker;
		if (cur == 0 || t_wake < cur) {
			iter.first_worker = t_wake;
		}
		size_t r = iter.range;
		size_t per = r / (size_t)iter.n_workers;
		size_t rem = r % (size_t)iter.n_workers;
		size_t start = (size_t)wid * per +
				(size_t)(wid < (int)rem ? wid : (int)rem);
		size_t end = start + per + (wid < (int)rem ? 1 : 0);
		bench_workload_t wl = { .in = iter.in, .out = iter.out,
					.range = r };
		if (wid < iter.n_workers) {
			bench_apply(&wl, start, end);
		}
		uint64_t t_done = bench_rdmtime();
		uint64_t prev = iter.last_done;
		if (t_done > prev) {
			iter.last_done = t_done;
		}
		k_sem_give(&done_sem[wid]);
	}
}

static float bench_in[BENCH_MAX_RANGE];
static volatile float bench_out[BENCH_MAX_RANGE];

static void run_one(bench_row_t *row, int n_workers, int range)
{
	iter.in = bench_in;
	iter.out = bench_out;
	iter.n_workers = n_workers;
	iter.active = 1;

	for (int i = 0; i < BENCH_WARMUP_REPS; i++) {
		iter.range = (size_t)range;
		iter.first_worker = 0;
		iter.last_done = 0;
		for (int w = 0; w < n_workers; w++) {
			k_sem_give(&start_sem[w]);
		}
		for (int w = 0; w < n_workers; w++) {
			k_sem_take(&done_sem[w], K_FOREVER);
		}
	}

	static uint64_t per_call[BENCH_TIMED_REPS];
	uint64_t sum_w2f = 0, sum_w2a = 0, sum_f2o = 0;
	for (int i = 0; i < BENCH_TIMED_REPS; i++) {
		iter.range = (size_t)range;
		iter.first_worker = 0;
		iter.last_done = 0;

		/* per-call: rdcycle on master (per-hart, but master is
		 * pinned to hart 0 so values are self-consistent).
		 * Breakdown: mtime (global) for the cross-hart deltas. */
		uint64_t t0 = bench_rdcycle();
		uint64_t m0 = bench_rdmtime();
		for (int w = 0; w < n_workers; w++) {
			k_sem_give(&start_sem[w]);
		}
		for (int w = 0; w < n_workers; w++) {
			k_sem_take(&done_sem[w], K_FOREVER);
		}
		uint64_t m1 = bench_rdmtime();
		uint64_t t1 = bench_rdcycle();
		per_call[i] = t1 - t0;

		uint64_t fw = iter.first_worker;
		uint64_t ld = iter.last_done;
		if (fw && fw > m0) {
			sum_w2f += (fw - m0);
		}
		if (ld && ld > m0) {
			sum_w2a += (ld - m0);
		}
		if (ld && m1 > ld) {
			sum_f2o += (m1 - ld);
		}
	}

	row->harness = "pthreads_raw";
	row->variant = "k_sem";
	row->n_workers = n_workers;
	row->range = range;
	row->reps = BENCH_TIMED_REPS;
	row->per_call_min = bench_min(per_call, BENCH_TIMED_REPS);
	row->per_call_max = bench_max(per_call, BENCH_TIMED_REPS);
	row->per_call_med = bench_median_inplace(per_call, BENCH_TIMED_REPS);
	row->wake_to_first_worker = sum_w2f / BENCH_TIMED_REPS;
	row->wake_to_all_finished = sum_w2a / BENCH_TIMED_REPS;
	row->finish_to_observed = sum_f2o / BENCH_TIMED_REPS;
}

int main(void)
{
	printf("bench_pthreads_raw: starting on %s "
	       "(MP_MAX_NUM_CPUS=%d)\n",
	       CONFIG_BOARD_TARGET, (int)CONFIG_MP_MAX_NUM_CPUS);
	/* Pin master to hart 0 — see bench_zephyr_threads.c for why. */
	k_thread_cpu_pin(k_current_get(), 0);
	for (int i = 0; i < BENCH_MAX_RANGE; i++) {
		bench_in[i] = (float)i;
	}

	for (int w = 0; w < BENCH_MAX_WORKERS; w++) {
		k_sem_init(&start_sem[w], 0, 1);
		k_sem_init(&done_sem[w], 0, 1);
	}

	pthread_t tids[BENCH_MAX_WORKERS];
	pthread_attr_t attrs[BENCH_MAX_WORKERS];

	/* Pre-spawn workers, pinned. Same as the affinity_smoketest. */
	for (int w = 0; w < BENCH_MAX_WORKERS; w++) {
		int rc = pthread_attr_init(&attrs[w]);
		if (rc != 0) {
			printf("FATAL: pthread_attr_init[%d] = %d\n", w, rc);
			sys_reboot(SYS_REBOOT_COLD);
		}
		cpu_set_t cs;
		CPU_ZERO(&cs);
		CPU_SET(w, &cs);
		rc = pthread_attr_setaffinity_np(&attrs[w], sizeof(cs), &cs);
		if (rc != 0) {
			printf("FATAL: pthread_attr_setaffinity_np[%d] = %d\n",
			       w, rc);
			sys_reboot(SYS_REBOOT_COLD);
		}
		rc = pthread_create(&tids[w], &attrs[w], worker_fn,
				    (void *)(uintptr_t)w);
		if (rc != 0) {
			printf("FATAL: pthread_create[%d] = %d\n", w, rc);
			sys_reboot(SYS_REBOOT_COLD);
		}
	}

	/* Sweep. */
	bench_row_t rows[BENCH_NWORKERS_COUNT * BENCH_RANGE_COUNT];
	int rcount = 0;
	for (int ni = 0; ni < BENCH_NWORKERS_COUNT; ni++) {
		int n = BENCH_NWORKERS[ni];
		for (int ri = 0; ri < BENCH_RANGE_COUNT; ri++) {
			run_one(&rows[rcount++], n, BENCH_RANGES[ri]);
		}
	}

	/* Shut workers down. */
	iter.active = 0;
	for (int w = 0; w < BENCH_MAX_WORKERS; w++) {
		k_sem_give(&start_sem[w]);
	}
	for (int w = 0; w < BENCH_MAX_WORKERS; w++) {
		pthread_join(tids[w], NULL);
		pthread_attr_destroy(&attrs[w]);
	}

	bench_emit_csv(rows, rcount);

	printf("bench_pthreads_raw: done\n");
	sys_reboot(SYS_REBOOT_COLD);
	return 0;
}
```

## src/bench_zephyr_threads.c
```c
/*
 * Copyright (c) 2026 The Authors
 * SPDX-License-Identifier: Apache-2.0
 *
 * Bench #2: native Zephyr k_thread + k_sem dispatch overhead.
 *
 * Pattern follows samples/tiled_matmul_mt_pool: pre-spawn N k_threads,
 * each pinned via k_thread_cpu_pin to a distinct hart, each spinning
 * in a `for(;;) k_sem_take(start_sem); ... k_sem_give(done_sem);` loop.
 * The master dispatches by giving every start_sem then taking every
 * done_sem in order.
 *
 * No POSIX, no pthreadpool: this is the absolute baseline for
 * cross-hart work dispatch using only Zephyr kernel objects. The cost
 * here is essentially:
 *   - master k_sem_give × N   (each potentially triggers a wake on the
 *                              target hart's run-queue, plus an IPI if
 *                              the target hart was idle)
 *   - workers run their body
 *   - master k_sem_take × N   (each may sleep until the worker calls
 *                              k_sem_give on done_sem, then IPI back)
 *
 * Crucially we instrument:
 *   wake_master_t   = rdcycle() right before the first start_sem give
 *   first_worker_t  = the earliest cycle any worker observed wakeup
 *                     (stamped by the worker via rdcycle right after
 *                     it returns from k_sem_take). One shared atomic
 *                     "min" register, written if smaller.
 *   last_done_t     = the largest cycle stamped by any worker right
 *                     after it called k_sem_give(done_sem)
 *   wake_observed_t = rdcycle() right after the master finishes its
 *                     last k_sem_take(done_sem)
 *
 * From those:
 *   wake_to_first_worker = first_worker_t - wake_master_t
 *   wake_to_all_finished = last_done_t   - wake_master_t
 *   finish_to_observed   = wake_observed_t - last_done_t
 */

#include <pthread.h>            /* only for the affinity attr in raw-pthread bench;
				 * unused here but the build needs the include
				 * present in case POSIX_API is on. We still
				 * exclude POSIX threads in this binary's prj. */
#include <stdint.h>
#include <stdio.h>
#include <stdlib.h>

#include <zephyr/arch/cpu.h>
#include <zephyr/kernel.h>
#include <zephyr/sys/reboot.h>

#include "bench_common.h"

#define BENCH_MAX_WORKERS 4
#define BENCH_WORKER_STACK_SIZE 16384

K_THREAD_STACK_ARRAY_DEFINE(bench_worker_stacks,
			    BENCH_MAX_WORKERS,
			    BENCH_WORKER_STACK_SIZE);
static struct k_thread bench_worker_data[BENCH_MAX_WORKERS];
static k_tid_t bench_worker_tids[BENCH_MAX_WORKERS];

static struct k_sem start_sem[BENCH_MAX_WORKERS];
static struct k_sem done_sem[BENCH_MAX_WORKERS];

/* Per-iteration shared state. Written by master, read+stamped by
 * workers, written by workers, read by master after the take loop. */
struct bench_iter_state {
	const float *in;
	volatile float *out;
	size_t range;
	int n_workers;
	int active;	/* set to 1 when shutting workers down */

	/* Cycle stamps (all rdcycle()). volatile so the master sees the
	 * worker's stores after the take loop, without us needing
	 * explicit barriers — we're on the same coherent memory and the
	 * sem give/take pair already orders these reads. */
	volatile uint64_t first_worker;
	volatile uint64_t last_done;
};
static volatile struct bench_iter_state iter;

static void worker_fn(void *arg1, void *arg2, void *arg3)
{
	int wid = (int)(uintptr_t)arg1;
	(void)arg2; (void)arg3;
	for (;;) {
		k_sem_take(&start_sem[wid], K_FOREVER);
		/* mtime, NOT rdcycle: rdcycle is per-hart and isn't
		 * comparable to the master's sample read on hart 0.
		 * mtime is a single global counter (CLINT mtime memory-
		 * mapped) so timestamps from different harts compose. */
		uint64_t t_wake = bench_rdmtime();
		if (iter.active == 0) {
			/* Shutdown signal — exit the worker. We won't
			 * give done_sem on this final iteration; main
			 * uses k_thread_join. */
			return;
		}
		/* Stamp first-worker observation. We use a CAS-free
		 * "if smaller" update because we only care about the
		 * earliest wake, and racy updates can only ever
		 * over-estimate (write a slightly later value); the
		 * 0-initial sentinel is special-cased. */
		uint64_t cur = iter.first_worker;
		if (cur == 0 || t_wake < cur) {
			iter.first_worker = t_wake;
		}

		/* Slice [start, end) for this worker. */
		size_t r = iter.range;
		size_t per = r / (size_t)iter.n_workers;
		size_t rem = r % (size_t)iter.n_workers;
		size_t start = (size_t)wid * per +
				(size_t)(wid < (int)rem ? wid : (int)rem);
		size_t end = start + per + (wid < (int)rem ? 1 : 0);
		bench_workload_t wl = { .in = iter.in, .out = iter.out,
					.range = r };
		if (wid < iter.n_workers) {
			bench_apply(&wl, start, end);
		}
		uint64_t t_done = bench_rdmtime();
		/* Update last_done with max — same racy-but-monotonic
		 * pattern as first_worker. */
		uint64_t prev = iter.last_done;
		if (t_done > prev) {
			iter.last_done = t_done;
		}
		k_sem_give(&done_sem[wid]);
	}
}

static float bench_in[BENCH_MAX_RANGE];
static volatile float bench_out[BENCH_MAX_RANGE];

static void run_one(bench_row_t *row, int n_workers, int range)
{
	iter.in = bench_in;
	iter.out = bench_out;
	iter.n_workers = n_workers;
	iter.active = 1;

	/* Warmup. */
	for (int i = 0; i < BENCH_WARMUP_REPS; i++) {
		iter.range = (size_t)range;
		iter.first_worker = 0;
		iter.last_done = 0;
		for (int w = 0; w < n_workers; w++) {
			k_sem_give(&start_sem[w]);
		}
		for (int w = 0; w < n_workers; w++) {
			k_sem_take(&done_sem[w], K_FOREVER);
		}
	}

	static uint64_t per_call[BENCH_TIMED_REPS];
	uint64_t sum_w2f = 0, sum_w2a = 0, sum_f2o = 0;
	for (int i = 0; i < BENCH_TIMED_REPS; i++) {
		iter.range = (size_t)range;
		iter.first_worker = 0;
		iter.last_done = 0;

		/* per-call cycles: rdcycle on master only. Local-hart
		 * counter, gives high-resolution dispatch cost. */
		uint64_t t0 = bench_rdcycle();
		uint64_t m0 = bench_rdmtime();
		for (int w = 0; w < n_workers; w++) {
			k_sem_give(&start_sem[w]);
		}
		for (int w = 0; w < n_workers; w++) {
			k_sem_take(&done_sem[w], K_FOREVER);
		}
		uint64_t m1 = bench_rdmtime();
		uint64_t t1 = bench_rdcycle();
		per_call[i] = t1 - t0;

		/* Breakdown uses mtime (global), so master m0 / m1 and
		 * worker first_worker / last_done are directly comparable.
		 * mtime ticks at 1 MHz on FireSim quad-rocket-saturn so
		 * each unit = 1000 target cycles at 1 GHz. */
		uint64_t fw = iter.first_worker;
		uint64_t ld = iter.last_done;
		if (fw && fw > m0) {
			sum_w2f += (fw - m0);
		}
		if (ld && ld > m0) {
			sum_w2a += (ld - m0);
		}
		if (ld && m1 > ld) {
			sum_f2o += (m1 - ld);
		}
	}

	row->harness = "k_thread";
	row->variant = "k_sem";
	row->n_workers = n_workers;
	row->range = range;
	row->reps = BENCH_TIMED_REPS;
	row->per_call_min = bench_min(per_call, BENCH_TIMED_REPS);
	row->per_call_max = bench_max(per_call, BENCH_TIMED_REPS);
	row->per_call_med = bench_median_inplace(per_call, BENCH_TIMED_REPS);
	row->wake_to_first_worker = sum_w2f / BENCH_TIMED_REPS;
	row->wake_to_all_finished = sum_w2a / BENCH_TIMED_REPS;
	row->finish_to_observed = sum_f2o / BENCH_TIMED_REPS;
}

int main(void)
{
	printf("bench_zephyr_threads: starting on %s "
	       "(MP_MAX_NUM_CPUS=%d)\n",
	       CONFIG_BOARD_TARGET, (int)CONFIG_MP_MAX_NUM_CPUS);
	/* Pin main to hart 0. Without this, when the master blocks on
	 * k_sem_take the scheduler is free to migrate it to another
	 * hart, and our t0/t1 rdcycle pair lands on different per-hart
	 * counters — producing nonsense per-call deltas (negative when
	 * cast back from uint64). On real hardware the cycle counters
	 * are coherent so this isn't an issue, but keeping the pin is
	 * a no-cost robustness win. */
	k_thread_cpu_pin(k_current_get(), 0);
	for (int i = 0; i < BENCH_MAX_RANGE; i++) {
		bench_in[i] = (float)i;
	}

	for (int w = 0; w < BENCH_MAX_WORKERS; w++) {
		k_sem_init(&start_sem[w], 0, 1);
		k_sem_init(&done_sem[w], 0, 1);
	}

	/* Spawn all 4 workers up front, pinned to harts 0..3 (master
	 * runs on hart 0 too, but Zephyr SMP scheduler is fine
	 * coexisting; the master only ever spends time inside k_sem_*).
	 * On FireSim quad-rocket-saturn, harts are 0..3 and the prj
	 * overlay sets MP_MAX_NUM_CPUS=4 (see backends/firesim_chipyard.conf). */
	for (int w = 0; w < BENCH_MAX_WORKERS; w++) {
		bench_worker_tids[w] = k_thread_create(
			&bench_worker_data[w], bench_worker_stacks[w],
			BENCH_WORKER_STACK_SIZE, worker_fn,
			(void *)(uintptr_t)w, NULL, NULL,
			K_PRIO_PREEMPT(1), 0, K_FOREVER);
		k_thread_cpu_pin(bench_worker_tids[w], w);
		k_thread_start(bench_worker_tids[w]);
	}

	/* Sweep. Each row uses the first n_workers of the pre-spawned
	 * thread set; the others stay parked on their start_sem. */
	bench_row_t rows[BENCH_NWORKERS_COUNT * BENCH_RANGE_COUNT];
	int rcount = 0;
	for (int ni = 0; ni < BENCH_NWORKERS_COUNT; ni++) {
		int n = BENCH_NWORKERS[ni];
		for (int ri = 0; ri < BENCH_RANGE_COUNT; ri++) {
			run_one(&rows[rcount++], n, BENCH_RANGES[ri]);
		}
	}

	/* Tell every worker to exit, then join. */
	iter.active = 0;
	for (int w = 0; w < BENCH_MAX_WORKERS; w++) {
		k_sem_give(&start_sem[w]);
	}
	for (int w = 0; w < BENCH_MAX_WORKERS; w++) {
		k_thread_join(bench_worker_tids[w], K_FOREVER);
	}

	bench_emit_csv(rows, rcount);

	printf("bench_zephyr_threads: done\n");
	sys_reboot(SYS_REBOOT_COLD);
	return 0;
}
```
